## CMakeLists.txt
```
# SPDX-License-Identifier: Apache-2.0

cmake_minimum_required(VERSION 3.20.0)

find_package(Zephyr REQUIRED HINTS $ENV{ZEPHYR_BASE})
project(peripheral_hr)

FILE(GLOB app_sources src/*.c)
target_sources(app PRIVATE
  ${app_sources}
  src/input.c
  src/output.c
  src/system.c
  )

zephyr_library_include_directories(${ZEPHYR_BASE}/samples/bluetooth)
```

## prj.conf
```kconfig
CONFIG_BT=y
CONFIG_BT_DEBUG_LOG=y
CONFIG_BT_SMP=y
CONFIG_BT_PERIPHERAL=y
CONFIG_BT_DIS=y
CONFIG_GPIO=y
CONFIG_PWM=y
CONFIG_PWM_LOG_LEVEL_DBG=y
CONFIG_BT_DEVICE_NAME="Key Finder 42"
CONFIG_BT_DEVICE_APPEARANCE=576
```

## src/main.c
```c
/* main.c - Application main entry point */

/*
 * Copyright (c) 2015-2016 Intel Corporation
 *
 * SPDX-License-Identifier: Apache-2.0
 */

#include <zephyr/types.h>
#include <stddef.h>
#include <string.h>
#include <errno.h>
#include <zephyr/sys/printk.h>
#include <zephyr/sys/byteorder.h>
#include <zephyr/drivers/gpio.h>
#include <zephyr/kernel.h>

#include <zephyr/bluetooth/bluetooth.h>
#include <zephyr/bluetooth/hci.h>
#include <zephyr/bluetooth/conn.h>
#include <zephyr/bluetooth/uuid.h>
#include <zephyr/bluetooth/gatt.h>

#include "input.h"
#include "output.h"
#include "system.h"

static const struct bt_data ad[] = {
	BT_DATA_BYTES(BT_DATA_FLAGS, (BT_LE_AD_GENERAL | BT_LE_AD_NO_BREDR)),
	BT_DATA_BYTES(BT_DATA_UUID16_ALL,
		      BT_UUID_16_ENCODE(BT_UUID_DIS_VAL))
};

/////////////////////////// BUTTON ///////////////////////////////////////////////

/*
 * Get button configuration from the devicetree sw0 alias. This is mandatory.
 */
#define SW0_NODE	DT_ALIAS(sw0)
#if !DT_NODE_HAS_STATUS(SW0_NODE, okay)
#error "Unsupported board: sw0 devicetree alias is not defined"
#endif
static const struct gpio_dt_spec button = GPIO_DT_SPEC_GET_OR(SW0_NODE, gpios,
							      {0});
static struct gpio_callback button_cb_data;

void button_pressed(const struct device *dev, struct gpio_callback *cb,
		    uint32_t pins)
{
	bt_input_set_button(1U);
}

////////////////////////////////////////////////////////////////////////////////////

static void connected(struct bt_conn *conn, uint8_t err)
{
	if (err) {
		printk("Connection failed (err 0x%02x)\n", err);
	} else {
		printk("Connected\n");
	}
}

static void disconnected(struct bt_conn *conn, uint8_t reason)
{
	printk("Disconnected (reason 0x%02x)\n", reason);
}

BT_CONN_CB_DEFINE(conn_callbacks) = {
	.connected = connected,
	.disconnected = disconnected,
};

static void bt_ready(void)
{
	int err;

	printk("Bluetooth initialized\n");

	err = bt_le_adv_start(BT_LE_ADV_CONN_NAME, ad, ARRAY_SIZE(ad), NULL, 0);
	if (err) {
		printk("Advertising failed to start (err %d)\n", err);
		return;
	}

	printk("Advertising successfully started\n");
}

static void auth_cancel(struct bt_conn *conn)
{
	char addr[BT_ADDR_LE_STR_LEN];

	bt_addr_le_to_str(bt_conn_get_dst(conn), addr, sizeof(addr));

	printk("Pairing cancelled: %s\n", addr);
}

static struct bt_conn_auth_cb auth_cb_display = {
	.cancel = auth_cancel,
};

int main(void)
{
	int err;

	int ret;

	if (!gpio_is_ready_dt(&button)) {
		printk("Error: button device %s is not ready\n",
		       button.port->name);
		return 0;
	}

	ret = gpio_pin_configure_dt(&button, GPIO_INPUT);
	if (ret != 0) {
		printk("Error %d: failed to configure %s pin %d\n",
		       ret, button.port->name, button.pin);
		return 0;
	}

	ret = gpio_pin_interrupt_configure_dt(&button,
					      GPIO_INT_EDGE_TO_ACTIVE);
	if (ret != 0) {
		printk("Error %d: failed to configure interrupt on %s pin %d\n",
			ret, button.port->name, button.pin);
		return 0;
	}

	gpio_init_callback(&button_cb_data, button_pressed, BIT(button.pin));
	gpio_add_callback(button.port, &button_cb_data);
	printk("Set up button at %s pin %d\n", button.port->name, button.pin);

	err = bt_enable(NULL);
	if (err) {
		printk("Bluetooth init failed (err %d)\n", err);
		return 0;
	}

	bt_ready();

	bt_conn_auth_cb_register(&auth_cb_display);

	/* Implement notification. At the moment there is no suitable way
	 * of starting delayed work so we do it here
	 */
	while (1) {
		k_sleep(K_SECONDS(1));

		/* Update system debug information */
        system_set_debug("No errors");  // Set your debug message as needed

		// Initialisation du bouton à zéro
		bt_input_set_button(0U);
	}
	return 0;
}
```

## src/input.c
```c
/** @file
 *  @brief Custom Input Service
 */

#include <errno.h>
#include <zephyr/init.h>
#include <zephyr/sys/__assert.h>
#include <stdbool.h>
#include <zephyr/types.h>

#include <zephyr/bluetooth/bluetooth.h>
#include <zephyr/bluetooth/conn.h>
#include <zephyr/bluetooth/gatt.h>
#include <zephyr/bluetooth/uuid.h>

#include "input.h"

#define LOG_LEVEL CONFIG_BT_INPUT_LOG_LEVEL
#include <zephyr/logging/log.h>
LOG_MODULE_REGISTER(input);

static uint8_t button_pressed = 0;

static void blvl_ccc_cfg_changed(const struct bt_gatt_attr *attr,
				       uint16_t value)
{
	ARG_UNUSED(attr);

	bool notif_enabled = (value == BT_GATT_CCC_NOTIFY);

	LOG_INF("Button Notifications %s", notif_enabled ? "enabled" : "disabled");
}

static ssize_t read_blvl(struct bt_conn *conn,
			       const struct bt_gatt_attr *attr, void *buf,
			       uint16_t len, uint16_t offset)
{
	uint8_t lvl8 = button_pressed;

	return bt_gatt_attr_read(conn, attr, buf, len, offset, &lvl8,
				 sizeof(lvl8));
}

BT_GATT_SERVICE_DEFINE(input,
	BT_GATT_PRIMARY_SERVICE(BT_UUID_DECLARE_16(0x1402)),
	BT_GATT_CHARACTERISTIC(BT_UUID_DECLARE_16(0x1405),
			       BT_GATT_CHRC_READ | BT_GATT_CHRC_NOTIFY,
			       BT_GATT_PERM_READ, read_blvl, NULL,
			       &button_pressed),
	BT_GATT_CCC(blvl_ccc_cfg_changed,
		    BT_GATT_PERM_READ | BT_GATT_PERM_WRITE),
);

static int input_init(void)
{
	return 0;
}

uint8_t bt_input_get_button(void)
{
	return button_pressed;
}

int bt_input_set_button(uint8_t pressed)
{
	int rc;

	if (pressed > 1U) {
		return -EINVAL;
	}

	button_pressed = pressed;

	rc = bt_gatt_notify(NULL, &input.attrs[1], &pressed, sizeof(pressed));

	return rc == -ENOTCONN ? 0 : rc;
}

SYS_INIT(input_init, APPLICATION, CONFIG_APPLICATION_INIT_PRIORITY);
```

## src/input.h
```c
#ifndef INCLUDE_INPUT_H_
#define INCLUDE_INPUT_H_

/**
 * @brief Input Service
 * @defgroup bt_custom_input Input Service
 * @ingroup bluetooth
 * @{
 *
 * [Experimental] Users should note that the APIs can change
 * as a part of ongoing development.
 */

#include <stdint.h>

#ifdef __cplusplus
extern "C" {
#endif

/** @brief Read button.
 *
 * Read whether or not the button is pressed
 *
 *  @return 1 if pressed, 0 if not
 */
uint8_t bt_input_get_button(void);

/** @brief Update button state.
 *
 * Update the characteristic value of the button
 * This will send a GATT notification to all current subscribers.
 *
 *  @param level The button state (0U or 1U)
 *
 *  @return Zero in case of success and error code in case of error.
 */
int bt_input_set_button(uint8_t level);



#ifdef __cplusplus
}
#endif

/**
 * @}
 */

#endif /* INCLUDE_INPUT_H_ */
```

## src/output.c
```c
#include <errno.h>
#include <zephyr/init.h>
#include <zephyr/sys/__assert.h>
#include <stdbool.h>
#include <zephyr/types.h>

#include <zephyr/bluetooth/bluetooth.h>
#include <zephyr/bluetooth/conn.h>
#include <zephyr/bluetooth/gatt.h>
#include <zephyr/bluetooth/uuid.h>
#include <zephyr/drivers/gpio.h>
#include <zephyr/kernel.h>
#include <zephyr/sys/printk.h>
#include <zephyr/device.h>
#include <zephyr/drivers/pwm.h>

#include "output.h"

#define LOG_LEVEL CONFIG_BT_OUTPUT_LOG_LEVEL
#include <zephyr/logging/log.h>
LOG_MODULE_REGISTER(output);

static bool led_state = false;
static int buzzer_value = 0;

static struct gpio_dt_spec led = GPIO_DT_SPEC_GET_OR(DT_ALIAS(led1), gpios, {0});

// En l'absence de buzzer, la led 0 fera office de buzzer (en PWM)
static const struct pwm_dt_spec pwm_led0 = PWM_DT_SPEC_GET(DT_ALIAS(pwm_led0));

static ssize_t write_led(struct bt_conn *conn,
                         const struct bt_gatt_attr *attr,
                         const void *buf, uint16_t len, uint16_t offset)
{
    if (len != sizeof(bool))
    {
        printk("error");
        return BT_GATT_ERR(BT_ATT_ERR_INVALID_ATTRIBUTE_LEN);
    }

    led_state = *((bool *)buf);

    // Controle de la LED en fonction de led_state
    gpio_pin_set_dt(&led, led_state);

    return len;
}

static ssize_t write_buzzer(struct bt_conn *conn,
                            const struct bt_gatt_attr *attr,
                            const void *buf, uint16_t len, uint16_t offset)
{
    if (len != sizeof(int))
    {
        printk("error");
        return BT_GATT_ERR(BT_ATT_ERR_INVALID_ATTRIBUTE_LEN);
    }

    buzzer_value = *((int *)buf);

    // Controle du buzzer en fonction de buzzer_value
	//printk("%d", buzzer_value);
    pwm_set_dt(&pwm_led0, buzzer_value, buzzer_value / 2);

    return len;
}

BT_GATT_SERVICE_DEFINE(output,
                       BT_GATT_PRIMARY_SERVICE(BT_UUID_DECLARE_16(0x1403)),
                       BT_GATT_CHARACTERISTIC(BT_UUID_DECLARE_16(0x1406),
                                              BT_GATT_CHRC_WRITE, BT_GATT_PERM_WRITE,
                                              NULL, write_buzzer, NULL),
                       BT_GATT_CHARACTERISTIC(BT_UUID_DECLARE_16(0x1407),
                                              BT_GATT_CHRC_WRITE, BT_GATT_PERM_WRITE,
                                              NULL, write_led, NULL),
);

int output_init(void)
{
    int ret;

    if (led.port && !device_is_ready(led.port)) {
		printk("Error %d: LED device %s is not ready; ignoring it\n",
		       ret, led.port->name);
		led.port = NULL;
	}
	if (led.port) {
		ret = gpio_pin_configure_dt(&led, GPIO_OUTPUT);
		if (ret != 0) {
			printk("Error %d: failed to configure LED device %s pin %d\n",
			       ret, led.port->name, led.pin);
			led.port = NULL;
		} else {
			printk("Set up LED at %s pin %d\n", led.port->name, led.pin);
		}
	}

    if (!device_is_ready(pwm_led0.dev)) {
		printk("Error: PWM device %s is not ready\n",
		       pwm_led0.dev->name);
		return 0;
	}

    led_state = false;
    gpio_pin_set_dt(&led, led_state);

    buzzer_value = 0U;
    pwm_set_dt(&pwm_led0, buzzer_value, buzzer_value / 2);

    return ret;
}

void output_set_led(bool state)
{
    led_state = state;

    gpio_pin_set_dt(&led, led_state);
}

void output_set_buzzer(int value)
{
    buzzer_value = value;

    pwm_set_dt(&pwm_led0, buzzer_value, buzzer_value / 2);
}

SYS_INIT(output_init, APPLICATION, CONFIG_APPLICATION_INIT_PRIORITY);
```

## src/output.h
```c
#ifndef OUTPUT_H_
#define OUTPUT_H_

#include <zephyr/types.h>

#ifdef __cplusplus
extern "C" {
#endif

int output_init(void);
void output_set_led(bool state);
void output_set_buzzer(int value);

#ifdef __cplusplus
}
#endif

#endif /* OUTPUT_H_ */
```

## src/system.c
```c
#include <errno.h>
#include <zephyr/init.h>
#include <zephyr/sys/__assert.h>
#include <string.h>
#include <zephyr/types.h>
#include <stddef.h>

#include <zephyr/bluetooth/bluetooth.h>
#include <zephyr/bluetooth/conn.h>
#include <zephyr/bluetooth/gatt.h>
#include <zephyr/bluetooth/uuid.h>

#include "system.h"

#define LOG_LEVEL CONFIG_BT_SYSTEM_LOG_LEVEL
#include <zephyr/logging/log.h>
LOG_MODULE_REGISTER(system);

static const char system_version[] = "1.4.2.3";
static char system_debug[] = "Generic error message goes here";

static void blvl_ccc_cfg_changed(const struct bt_gatt_attr *attr,
				       uint16_t value)
{
	ARG_UNUSED(attr);

	bool notif_enabled = (value == BT_GATT_CCC_NOTIFY);

	LOG_INF("Debug Notifications %s", notif_enabled ? "enabled" : "disabled");
}


static ssize_t system_read_version(struct bt_conn *conn,
                            const struct bt_gatt_attr *attr, void *buf,
                            uint16_t len, uint16_t offset)
{
    return bt_gatt_attr_read(conn, attr, buf, len, offset,
                             system_version, sizeof(system_version));
}

static ssize_t system_read_debug(struct bt_conn *conn,
                          const struct bt_gatt_attr *attr, void *buf,
                          uint16_t len, uint16_t offset)
{
    return bt_gatt_attr_read(conn, attr, buf, len, offset,
                             system_debug, sizeof(system_debug));
}

static ssize_t system_notify_debug(struct bt_conn *conn,
                            const struct bt_gatt_attr *attr, void *buf,
                            uint16_t len, uint16_t offset)
{
    // Notify current debug message
    return bt_gatt_notify(NULL, attr, system_debug, sizeof(system_debug));
}

BT_GATT_SERVICE_DEFINE(system,
                        BT_GATT_PRIMARY_SERVICE(BT_UUID_DECLARE_16(0x1401)),
                        BT_GATT_CHARACTERISTIC(BT_UUID_DECLARE_16(0x1404),
                                              BT_GATT_CHRC_READ, BT_GATT_PERM_READ,
                                              system_read_version, NULL, NULL),
                        BT_GATT_CHARACTERISTIC(BT_UUID_DECLARE_16(0x1408),
                                              BT_GATT_CHRC_READ | BT_GATT_CHRC_NOTIFY,
                                              BT_GATT_PERM_READ, system_read_debug,
                                              NULL, system_notify_debug),
                        BT_GATT_CCC(blvl_ccc_cfg_changed,
		                                    BT_GATT_PERM_READ | BT_GATT_PERM_WRITE),
);

int system_init(void)
{
    return 0;
}

void system_set_debug(const char *debug_message)
{
    // Update debug message
    strncpy(system_debug, debug_message, sizeof(system_debug));
}

SYS_INIT(system_init, APPLICATION, CONFIG_APPLICATION_INIT_PRIORITY);
```

## src/system.h
```c
#ifndef SYSTEM_H_
#define SYSTEM_H_

#include <zephyr/types.h>
#include <stddef.h>

#ifdef __cplusplus
extern "C" {
#endif

int system_init(void);
void system_set_debug(const char *debug_message);

#ifdef __cplusplus
}
#endif

#endif /* SYSTEM_H_ */
```
